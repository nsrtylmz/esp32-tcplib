## Kconfig
```kconfig
menu "tcplib"
    config TCPLIB_IPV6
        bool "Enable IPv6 support"
        default n
        depends on LWIP_IPV6
        help
            TcpClient::connect() accepts IPv6 addresses and hostnames that resolve
            to IPv6, and TcpListener accepts both IPv4 and IPv6 clients (one
            dual-stack socket). Off: IPv4 only.
endmenu
```

## examples/tcp_client/main/Kconfig.projbuild
```kconfig
menu "Example Configuration"

    choice EXAMPLE_IP_MODE
        prompt "IP Version"
        default EXAMPLE_IPV4
        help
            Address family of the server address below.

        config EXAMPLE_IPV4
            bool "IPV4"

        config EXAMPLE_IPV6
            bool "IPV6"
            depends on LWIP_IPV6
            select TCPLIB_IPV6
            help
                Also turns on tcplib's IPv6 support (CONFIG_TCPLIB_IPV6).
    endchoice

    config EXAMPLE_HOST_IPV4_ADDR
        string "IPV4 Address"
        default "192.168.0.165"
        depends on EXAMPLE_IPV4
        help
            IPv4 address or hostname of the server.

    config EXAMPLE_HOST_IPV6_ADDR
        string "IPV6 Address"
        default "FE80::30AD:E57B:C212:68AD"
        depends on EXAMPLE_IPV6
        help
            IPv6 address of the server, without a "%zone" suffix.
            A link-local address (fe80::...) is reached through the interface
            selected below.

    config EXAMPLE_HOST_PORT
        int "Port"
        range 1 65535
        default 3333
        help
            Server port.

    config EXAMPLE_CONNECT_TIMEOUT_MS
        int "Connect timeout (ms)"
        range 100 60000
        default 10000
        help
            How long one connection attempt may take (TCP handshake only, not DNS).

    choice EXAMPLE_INTERFACE
        prompt "Interface selection"
        default EXAMPLE_IFACE_AUTO
        help
            Network interface used for the connection (TcpOptions::netif_key).

        config EXAMPLE_IFACE_AUTO
            bool "Auto"
            help
                Any interface (routing decides). Link-local IPv6 addresses use
                the default interface.

        config EXAMPLE_USER_SPECIFIED_IFACE
            bool "User specified interface"
    endchoice

    config EXAMPLE_NETIF_KEY
        string "Interface key (esp_netif)"
        default "WIFI_STA_DEF"
        depends on EXAMPLE_USER_SPECIFIED_IFACE
        help
            esp_netif key of the interface, e.g. "WIFI_STA_DEF" (Wi-Fi station)
            or "ETH_DEF" (Ethernet).

endmenu
```

## examples/tcp_listener/main/Kconfig.projbuild
```kconfig
menu "Listener Configuration"

    config LISTENER_MAX_CLIENTS
        int "Max connections per server"
        range 1 8
        default 3
        help
            Connections a server serves at the same time. A client beyond that
            is told "busy" and closed. Keep the total of all servers below
            CONFIG_LWIP_MAX_SOCKETS (each listener also uses one socket).

    config LISTENER_IDLE_TIMEOUT_S
        int "Close idle connections after (s, 0 = never)"
        range 0 3600
        default 60

    menu "Server 1"
        config LISTENER_SERVER1_ENABLE
            bool "Enable server 1"
            default y

        config LISTENER_SERVER1_PORT
            int "Port"
            range 1 65535
            default 5001
            depends on LISTENER_SERVER1_ENABLE

        choice LISTENER_SERVER1_IFACE
            prompt "Accept connections from"
            default LISTENER_SERVER1_IFACE_WIFI_STA
            depends on LISTENER_SERVER1_ENABLE
            help
                Interface the listening socket is bound to (TcpOptions::netif_key).
                Connections arriving on any other interface are refused.

            config LISTENER_SERVER1_IFACE_ANY
                bool "Any interface"
            config LISTENER_SERVER1_IFACE_WIFI_STA
                bool "Wi-Fi station only (WIFI_STA_DEF)"
            config LISTENER_SERVER1_IFACE_ETH
                bool "Ethernet only (ETH_DEF)"
            config LISTENER_SERVER1_IFACE_CUSTOM
                bool "Custom esp_netif key"
        endchoice

        config LISTENER_SERVER1_IFACE_KEY
            string "esp_netif key"
            default "WIFI_AP_DEF"
            depends on LISTENER_SERVER1_IFACE_CUSTOM
    endmenu

    menu "Server 2"
        config LISTENER_SERVER2_ENABLE
            bool "Enable server 2"
            default y

        config LISTENER_SERVER2_PORT
            int "Port"
            range 1 65535
            default 5002
            depends on LISTENER_SERVER2_ENABLE

        choice LISTENER_SERVER2_IFACE
            prompt "Accept connections from"
            default LISTENER_SERVER2_IFACE_ETH
            depends on LISTENER_SERVER2_ENABLE
            help
                Interface the listening socket is bound to (TcpOptions::netif_key).
                Connections arriving on any other interface are refused.

            config LISTENER_SERVER2_IFACE_ANY
                bool "Any interface"
            config LISTENER_SERVER2_IFACE_WIFI_STA
                bool "Wi-Fi station only (WIFI_STA_DEF)"
            config LISTENER_SERVER2_IFACE_ETH
                bool "Ethernet only (ETH_DEF)"
            config LISTENER_SERVER2_IFACE_CUSTOM
                bool "Custom esp_netif key"
        endchoice

        config LISTENER_SERVER2_IFACE_KEY
            string "esp_netif key"
            default "WIFI_AP_DEF"
            depends on LISTENER_SERVER2_IFACE_CUSTOM
    endmenu

    menu "Server 3"
        config LISTENER_SERVER3_ENABLE
            bool "Enable server 3"
            default y

        config LISTENER_SERVER3_PORT
            int "Port"
            range 1 65535
            default 5003
            depends on LISTENER_SERVER3_ENABLE

        choice LISTENER_SERVER3_IFACE
            prompt "Accept connections from"
            default LISTENER_SERVER3_IFACE_ANY
            depends on LISTENER_SERVER3_ENABLE
            help
                Interface the listening socket is bound to (TcpOptions::netif_key).
                Connections arriving on any other interface are refused.

            config LISTENER_SERVER3_IFACE_ANY
                bool "Any interface"
            config LISTENER_SERVER3_IFACE_WIFI_STA
                bool "Wi-Fi station only (WIFI_STA_DEF)"
            config LISTENER_SERVER3_IFACE_ETH
                bool "Ethernet only (ETH_DEF)"
            config LISTENER_SERVER3_IFACE_CUSTOM
                bool "Custom esp_netif key"
        endchoice

        config LISTENER_SERVER3_IFACE_KEY
            string "esp_netif key"
            default "WIFI_AP_DEF"
            depends on LISTENER_SERVER3_IFACE_CUSTOM
    endmenu

endmenu
```

## examples/tcp_multi_client/main/Kconfig.projbuild
```kconfig
menu "Multi Client Configuration"

    config MULTI_DEFAULT_HOST
        string "Default server address"
        default "192.168.1.100"
        help
            Server used by every client whose own address is left empty.
            IPv4 address, hostname, or IPv6 address (IPv6 needs
            tcplib → Enable IPv6 support).

    config MULTI_DEFAULT_PORT
        int "Default server port"
        range 1 65535
        default 3333

    config MULTI_SEND_PERIOD_MS
        int "Message period (ms)"
        range 100 600000
        default 2000
        help
            Each connected client sends one numbered line this often and
            checks that the server echoes it back.

    config MULTI_CONNECT_TIMEOUT_MS
        int "Connect timeout (ms)"
        range 100 60000
        default 10000

    config MULTI_RETRY_DELAY_MS
        int "Delay before reconnecting (ms)"
        range 100 600000
        default 5000

    menu "Client 1"
        config MULTI_CLIENT1_ENABLE
            bool "Enable client 1"
            default y

        config MULTI_CLIENT1_HOST
            string "Server address (empty = default)"
            default ""
            depends on MULTI_CLIENT1_ENABLE

        config MULTI_CLIENT1_PORT
            int "Server port (0 = default)"
            range 0 65535
            default 0
            depends on MULTI_CLIENT1_ENABLE

        choice MULTI_CLIENT1_IFACE
            prompt "Network interface"
            default MULTI_CLIENT1_IFACE_ANY
            depends on MULTI_CLIENT1_ENABLE
            help
                Interface this client's socket is bound to (TcpOptions::netif_key).

            config MULTI_CLIENT1_IFACE_ANY
                bool "Any (routing decides)"
            config MULTI_CLIENT1_IFACE_WIFI_STA
                bool "Wi-Fi station (WIFI_STA_DEF)"
            config MULTI_CLIENT1_IFACE_ETH
                bool "Ethernet (ETH_DEF)"
            config MULTI_CLIENT1_IFACE_CUSTOM
                bool "Custom esp_netif key"
        endchoice

        config MULTI_CLIENT1_IFACE_KEY
            string "esp_netif key"
            default "WIFI_STA_DEF"
            depends on MULTI_CLIENT1_IFACE_CUSTOM
    endmenu

    menu "Client 2"
        config MULTI_CLIENT2_ENABLE
            bool "Enable client 2"
            default y

        config MULTI_CLIENT2_HOST
            string "Server address (empty = default)"
            default ""
            depends on MULTI_CLIENT2_ENABLE

        config MULTI_CLIENT2_PORT
            int "Server port (0 = default)"
            range 0 65535
            default 0
            depends on MULTI_CLIENT2_ENABLE

        choice MULTI_CLIENT2_IFACE
            prompt "Network interface"
            default MULTI_CLIENT2_IFACE_WIFI_STA
            depends on MULTI_CLIENT2_ENABLE
            help
                Interface this client's socket is bound to (TcpOptions::netif_key).

            config MULTI_CLIENT2_IFACE_ANY
                bool "Any (routing decides)"
            config MULTI_CLIENT2_IFACE_WIFI_STA
                bool "Wi-Fi station (WIFI_STA_DEF)"
            config MULTI_CLIENT2_IFACE_ETH
                bool "Ethernet (ETH_DEF)"
            config MULTI_CLIENT2_IFACE_CUSTOM
                bool "Custom esp_netif key"
        endchoice

        config MULTI_CLIENT2_IFACE_KEY
            string "esp_netif key"
            default "WIFI_STA_DEF"
            depends on MULTI_CLIENT2_IFACE_CUSTOM
    endmenu

    menu "Client 3"
        config MULTI_CLIENT3_ENABLE
            bool "Enable client 3"
            default y

        config MULTI_CLIENT3_HOST
            string "Server address (empty = default)"
            default ""
            depends on MULTI_CLIENT3_ENABLE

        config MULTI_CLIENT3_PORT
            int "Server port (0 = default)"
            range 0 65535
            default 0
            depends on MULTI_CLIENT3_ENABLE

        choice MULTI_CLIENT3_IFACE
            prompt "Network interface"
            default MULTI_CLIENT3_IFACE_ANY
            depends on MULTI_CLIENT3_ENABLE
            help
                Interface this client's socket is bound to (TcpOptions::netif_key).

            config MULTI_CLIENT3_IFACE_ANY
                bool "Any (routing decides)"
            config MULTI_CLIENT3_IFACE_WIFI_STA
                bool "Wi-Fi station (WIFI_STA_DEF)"
            config MULTI_CLIENT3_IFACE_ETH
                bool "Ethernet (ETH_DEF)"
            config MULTI_CLIENT3_IFACE_CUSTOM
                bool "Custom esp_netif key"
        endchoice

        config MULTI_CLIENT3_IFACE_KEY
            string "esp_netif key"
            default "WIFI_STA_DEF"
            depends on MULTI_CLIENT3_IFACE_CUSTOM
    endmenu

endmenu
```
